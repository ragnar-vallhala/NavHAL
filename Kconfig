## src/board/atmega328p/Kconfig
```kconfig
# vim: ft=kconfig
# Board identity string for the bare ATmega328P board (M7 §7.2).
# Sourced at top level.

config BOARD
    string
    default "atmega328p" if BOARD_ATMEGA328P

# ---- This board's description ----
#
# Every macro board.h used to define, as Kconfig symbols; tools/kconfig.py turns
# them into the board.h that code includes. Port indices are relative to this
# ISA's first port, which is B rather than A -- see GPIO_PORT_BASE.
#
# VAL_ carries the spellings no integer can: HAL_IRQ_USART_RX is this console's
# interrupt and has no instance number, TIM1 and HAL_ADC_0 are names, and
# BOARD_ADC_PIN is an alias for the A0 pin macro above it.

# 40 macros
config PIN_LED_BUILTIN_PORT
    int
    default 0 if BOARD_ATMEGA328P
config PIN_LED_BUILTIN_PIN
    int
    default 5 if BOARD_ATMEGA328P
config VAL_LED_ON
    string
    default "HAL_GPIO_HIGH" if BOARD_ATMEGA328P
config VAL_LED_OFF
    string
    default "HAL_GPIO_LOW" if BOARD_ATMEGA328P
config PIN_USER_BUTTON_PORT
    int
    default 2 if BOARD_ATMEGA328P
config PIN_USER_BUTTON_PIN
    int
    default 2 if BOARD_ATMEGA328P
config PIN_D0_PORT
    int
    default 2 if BOARD_ATMEGA328P
config PIN_D0_PIN
    int
    default 0 if BOARD_ATMEGA328P
config PIN_D1_PORT
    int
    default 2 if BOARD_ATMEGA328P
config PIN_D1_PIN
    int
    default 1 if BOARD_ATMEGA328P
config PIN_D2_PORT
    int
    default 2 if BOARD_ATMEGA328P
config PIN_D2_PIN
    int
    default 2 if BOARD_ATMEGA328P
config PIN_D3_PORT
    int
    default 2 if BOARD_ATMEGA328P
config PIN_D3_PIN
    int
    default 3 if BOARD_ATMEGA328P
config PIN_D4_PORT
    int
    default 2 if BOARD_ATMEGA328P
config PIN_D4_PIN
    int
    default 4 if BOARD_ATMEGA328P
config PIN_D5_PORT
    int
    default 2 if BOARD_ATMEGA328P
config PIN_D5_PIN
    int
    default 5 if BOARD_ATMEGA328P
config PIN_D6_PORT
    int
    default 2 if BOARD_ATMEGA328P
config PIN_D6_PIN
    int
    default 6 if BOARD_ATMEGA328P
config PIN_D7_PORT
    int
    default 2 if BOARD_ATMEGA328P
config PIN_D7_PIN
    int
    default 7 if BOARD_ATMEGA328P
config PIN_D8_PORT
    int
    default 0 if BOARD_ATMEGA328P
config PIN_D8_PIN
    int
    default 0 if BOARD_ATMEGA328P
config PIN_D9_PORT
    int
    default 0 if BOARD_ATMEGA328P
config PIN_D9_PIN
    int
    default 1 if BOARD_ATMEGA328P
config PIN_D10_PORT
    int
    default 0 if BOARD_ATMEGA328P
config PIN_D10_PIN
    int
    default 2 if BOARD_ATMEGA328P
config PIN_D11_PORT
    int
    default 0 if BOARD_ATMEGA328P
config PIN_D11_PIN
    int
    default 3 if BOARD_ATMEGA328P
config PIN_D12_PORT
    int
    default 0 if BOARD_ATMEGA328P
config PIN_D12_PIN
    int
    default 4 if BOARD_ATMEGA328P
config PIN_D13_PORT
    int
    default 0 if BOARD_ATMEGA328P
config PIN_D13_PIN
    int
    default 5 if BOARD_ATMEGA328P
config PIN_A0_PORT
    int
    default 1 if BOARD_ATMEGA328P
config PIN_A0_PIN
    int
    default 0 if BOARD_ATMEGA328P
config PIN_A1_PORT
    int
    default 1 if BOARD_ATMEGA328P
config PIN_A1_PIN
    int
    default 1 if BOARD_ATMEGA328P
config PIN_A2_PORT
    int
    default 1 if BOARD_ATMEGA328P
config PIN_A2_PIN
    int
    default 2 if BOARD_ATMEGA328P
config PIN_A3_PORT
    int
    default 1 if BOARD_ATMEGA328P
config PIN_A3_PIN
    int
    default 3 if BOARD_ATMEGA328P
config PIN_A4_PORT
    int
    default 1 if BOARD_ATMEGA328P
config PIN_A4_PIN
    int
    default 4 if BOARD_ATMEGA328P
config PIN_A5_PORT
    int
    default 1 if BOARD_ATMEGA328P
config PIN_A5_PIN
    int
    default 5 if BOARD_ATMEGA328P
config VAL_BOARD_ADC
    string
    default "HAL_ADC_0" if BOARD_ATMEGA328P
config VAL_BOARD_ADC_PIN
    string
    default "A0" if BOARD_ATMEGA328P
config NUM_BOARD_ADC_CHANNEL
    int
    default 0 if BOARD_ATMEGA328P
config VAL_BOARD_CONSOLE_UART
    string
    default "HAL_UART_0" if BOARD_ATMEGA328P
config VAL_BOARD_CONSOLE_UART_IRQ
    string
    default "HAL_IRQ_USART_RX" if BOARD_ATMEGA328P
config VAL_BOARD_GP_TIMER
    string
    default "TIM1" if BOARD_ATMEGA328P
config VAL_BOARD_PWM_TIMER
    string
    default "TIM1" if BOARD_ATMEGA328P
config NUM_BOARD_PWM_CHANNEL
    int
    default 1 if BOARD_ATMEGA328P
config PIN_BOARD_PWM_PIN_PORT
    int
    default 0 if BOARD_ATMEGA328P
config PIN_BOARD_PWM_PIN_PIN
    int
    default 1 if BOARD_ATMEGA328P
config VAL_BOARD_PWM_AF
    string
    default "HAL_GPIO_AF1" if BOARD_ATMEGA328P
config VAL_BOARD_I2C_BUS
    string
    default "HAL_I2C_0" if BOARD_ATMEGA328P
config PIN_BOARD_I2C_SCL_PORT
    int
    default 1 if BOARD_ATMEGA328P
config PIN_BOARD_I2C_SCL_PIN
    int
    default 5 if BOARD_ATMEGA328P
config PIN_BOARD_I2C_SDA_PORT
    int
    default 1 if BOARD_ATMEGA328P
config PIN_BOARD_I2C_SDA_PIN
    int
    default 4 if BOARD_ATMEGA328P
config VAL_BOARD_SPI_BUS
    string
    default "HAL_SPI_0" if BOARD_ATMEGA328P
config PIN_BOARD_SPI_CS_PORT
    int
    default 0 if BOARD_ATMEGA328P
config PIN_BOARD_SPI_CS_PIN
    int
    default 2 if BOARD_ATMEGA328P
config NUM_BOARD_XTAL_FREQ_HZ
    int
    default 16000000 if BOARD_ATMEGA328P
```

## src/board/navixdev/Kconfig
```kconfig
# vim: ft=kconfig
# Board identity string for NAVIXDEV. Sourced at top level.

config BOARD
    string
    default "navixdev" if BOARD_NAVIXDEV

# ---- This board's description ----
#
# Every macro board.h used to define, as Kconfig symbols; tools/kconfig.py turns
# them into the board.h that code includes, so this file is the single place the
# board is described and any value can be overridden in .config.
#
# PIN_<name>_PORT/_PIN become HAL_GPIO_PIN(); NUM_<name> an integer; VAL_<name> is
# emitted verbatim, for spellings no integer can carry.

# 41 macros
config PIN_LED_RGB_BLUE_PORT
    int
    default 1 if BOARD_NAVIXDEV
config PIN_LED_RGB_BLUE_PIN
    int
    default 12 if BOARD_NAVIXDEV
config PIN_LED_RGB_RED_PORT
    int
    default 1 if BOARD_NAVIXDEV
config PIN_LED_RGB_RED_PIN
    int
    default 13 if BOARD_NAVIXDEV
config PIN_LED_RGB_GREEN_PORT
    int
    default 1 if BOARD_NAVIXDEV
config PIN_LED_RGB_GREEN_PIN
    int
    default 14 if BOARD_NAVIXDEV
config VAL_LED_BUILTIN
    string
    default "LED_RGB_GREEN" if BOARD_NAVIXDEV
config VAL_LED_ON
    string
    default "HAL_GPIO_HIGH" if BOARD_NAVIXDEV
config VAL_LED_OFF
    string
    default "HAL_GPIO_LOW" if BOARD_NAVIXDEV
config PIN_BUZZER_PORT
    int
    default 1 if BOARD_NAVIXDEV
config PIN_BUZZER_PIN
    int
    default 15 if BOARD_NAVIXDEV
config VAL_BOARD_CONSOLE_UART
    string
    default "HAL_UART_2" if BOARD_NAVIXDEV
config VAL_BOARD_CONSOLE_UART_IRQ
    string
    default "USART2_IRQn" if BOARD_NAVIXDEV
config VAL_BOARD_GPS_UART
    string
    default "HAL_UART_6" if BOARD_NAVIXDEV
config PIN_BOARD_GPS_TX_PORT
    int
    default 2 if BOARD_NAVIXDEV
config PIN_BOARD_GPS_TX_PIN
    int
    default 6 if BOARD_NAVIXDEV
config PIN_BOARD_GPS_RX_PORT
    int
    default 2 if BOARD_NAVIXDEV
config PIN_BOARD_GPS_RX_PIN
    int
    default 7 if BOARD_NAVIXDEV
config VAL_BOARD_GP_TIMER
    string
    default "TIM4" if BOARD_NAVIXDEV
config VAL_BOARD_PWM_TIMER
    string
    default "TIM1" if BOARD_NAVIXDEV
config NUM_BOARD_PWM_CHANNEL
    int
    default 1 if BOARD_NAVIXDEV
config PIN_BOARD_PWM_PIN_PORT
    int
    default 0 if BOARD_NAVIXDEV
config PIN_BOARD_PWM_PIN_PIN
    int
    default 8 if BOARD_NAVIXDEV
config VAL_BOARD_PWM_AF
    string
    default "HAL_GPIO_AF1" if BOARD_NAVIXDEV
config VAL_BOARD_PWM1_TIMER
    string
    default "TIM1" if BOARD_NAVIXDEV
config PIN_BOARD_PWM1_CH1_PORT
    int
    default 0 if BOARD_NAVIXDEV
config PIN_BOARD_PWM1_CH1_PIN
    int
    default 8 if BOARD_NAVIXDEV
config PIN_BOARD_PWM1_CH2_PORT
    int
    default 0 if BOARD_NAVIXDEV
config PIN_BOARD_PWM1_CH2_PIN
    int
    default 9 if BOARD_NAVIXDEV
config PIN_BOARD_PWM1_CH3_PORT
    int
    default 0 if BOARD_NAVIXDEV
config PIN_BOARD_PWM1_CH3_PIN
    int
    default 10 if BOARD_NAVIXDEV
config PIN_BOARD_PWM1_CH4_PORT
    int
    default 0 if BOARD_NAVIXDEV
config PIN_BOARD_PWM1_CH4_PIN
    int
    default 11 if BOARD_NAVIXDEV
config VAL_BOARD_PWM2_TIMER
    string
    default "TIM5" if BOARD_NAVIXDEV
config PIN_BOARD_PWM2_CH1_PORT
    int
    default 0 if BOARD_NAVIXDEV
config PIN_BOARD_PWM2_CH1_PIN
    int
    default 0 if BOARD_NAVIXDEV
config PIN_BOARD_PWM2_CH2_PORT
    int
    default 0 if BOARD_NAVIXDEV
config PIN_BOARD_PWM2_CH2_PIN
    int
    default 1 if BOARD_NAVIXDEV
config PIN_BOARD_PWM2_CH3_PORT
    int
    default 0 if BOARD_NAVIXDEV
config PIN_BOARD_PWM2_CH3_PIN
    int
    default 2 if BOARD_NAVIXDEV
config PIN_BOARD_PWM2_CH4_PORT
    int
    default 0 if BOARD_NAVIXDEV
config PIN_BOARD_PWM2_CH4_PIN
    int
    default 3 if BOARD_NAVIXDEV
config VAL_BOARD_MOTOR_TIMER
    string
    default "TIM3" if BOARD_NAVIXDEV
config PIN_BOARD_MOTOR1_PORT
    int
    default 1 if BOARD_NAVIXDEV
config PIN_BOARD_MOTOR1_PIN
    int
    default 4 if BOARD_NAVIXDEV
config PIN_BOARD_MOTOR2_PORT
    int
    default 1 if BOARD_NAVIXDEV
config PIN_BOARD_MOTOR2_PIN
    int
    default 5 if BOARD_NAVIXDEV
config PIN_BOARD_MOTOR3_PORT
    int
    default 1 if BOARD_NAVIXDEV
config PIN_BOARD_MOTOR3_PIN
    int
    default 0 if BOARD_NAVIXDEV
config PIN_BOARD_MOTOR4_PORT
    int
    default 1 if BOARD_NAVIXDEV
config PIN_BOARD_MOTOR4_PIN
    int
    default 1 if BOARD_NAVIXDEV
config VAL_BOARD_SPI_BUS
    string
    default "HAL_SPI_1" if BOARD_NAVIXDEV
config PIN_BOARD_SPI_CS_PORT
    int
    default 0 if BOARD_NAVIXDEV
config PIN_BOARD_SPI_CS_PIN
    int
    default 4 if BOARD_NAVIXDEV
config VAL_BOARD_I2C_BUS
    string
    default "HAL_I2C_1" if BOARD_NAVIXDEV
config PIN_BOARD_I2C_SCL_PORT
    int
    default 1 if BOARD_NAVIXDEV
config PIN_BOARD_I2C_SCL_PIN
    int
    default 8 if BOARD_NAVIXDEV
config PIN_BOARD_I2C_SDA_PORT
    int
    default 1 if BOARD_NAVIXDEV
config PIN_BOARD_I2C_SDA_PIN
    int
    default 9 if BOARD_NAVIXDEV
config PIN_BOARD_IMU_INT1_PORT
    int
    default 2 if BOARD_NAVIXDEV
config PIN_BOARD_IMU_INT1_PIN
    int
    default 0 if BOARD_NAVIXDEV
config PIN_BOARD_IMU_INT2_PORT
    int
    default 2 if BOARD_NAVIXDEV
config PIN_BOARD_IMU_INT2_PIN
    int
    default 1 if BOARD_NAVIXDEV
config NUM_BOARD_HSI_FREQ_HZ
    int
    default 16000000 if BOARD_NAVIXDEV
config NUM_BOARD_HSE_FREQ_HZ
    int
    default 8000000 if BOARD_NAVIXDEV

# ---- SDIO ----
# The bus signals are fixed by the alternate-function mux rather than freely
# chosen: pointing one at a pin the mux cannot route gives a build that compiles
# and a bus that never transfers. Check the datasheet before changing one.

config NUM_BOARD_SDIO_AF
    int
    default 12 if BOARD_NAVIXDEV
config PIN_BOARD_SDIO_D0_PORT
    int
    default 2 if BOARD_NAVIXDEV
config PIN_BOARD_SDIO_D0_PIN
    int
    default 8 if BOARD_NAVIXDEV
config PIN_BOARD_SDIO_D1_PORT
    int
    default 2 if BOARD_NAVIXDEV
config PIN_BOARD_SDIO_D1_PIN
    int
    default 9 if BOARD_NAVIXDEV
config PIN_BOARD_SDIO_D2_PORT
    int
    default 2 if BOARD_NAVIXDEV
config PIN_BOARD_SDIO_D2_PIN
    int
    default 10 if BOARD_NAVIXDEV
config PIN_BOARD_SDIO_D3_PORT
    int
    default 2 if BOARD_NAVIXDEV
config PIN_BOARD_SDIO_D3_PIN
    int
    default 11 if BOARD_NAVIXDEV
config PIN_BOARD_SDIO_CK_PORT
    int
    default 2 if BOARD_NAVIXDEV
config PIN_BOARD_SDIO_CK_PIN
    int
    default 12 if BOARD_NAVIXDEV
config PIN_BOARD_SDIO_CMD_PORT
    int
    default 3 if BOARD_NAVIXDEV
config PIN_BOARD_SDIO_CMD_PIN
    int
    default 2 if BOARD_NAVIXDEV

# Card detect is an ordinary GPIO, not an SDIO signal, so it can be anywhere.
# Its presence is the flag: a board that declares it gets BOARD_SD_CD in the
# generated header, and the driver compiles its card-detect path on that.
config PIN_BOARD_SD_CD_PORT
    int
    default 2 if BOARD_NAVIXDEV
config PIN_BOARD_SD_CD_PIN
    int
    default 5 if BOARD_NAVIXDEV
```
