## cmake/defconfigs/avr_atmega328p.defconfig
```kconfig
# NavHAL defconfig — AVR / ATmega328P (e.g. Arduino Uno).
#
# Minimal Kconfig fragment: selects the arch / vendor / family / board.
# Everything else cascades from Kconfig defaults (drivers, samples, etc.).
#
# Used by cmake/toolchains/avr-toolchain.cmake — when that toolchain file
# is active, CMakeLists.txt copies this into .config before running
# tools/kconfig.py.

CONFIG_ARCH_AVR8=y
CONFIG_VENDOR_MICROCHIP=y
CONFIG_FAMILY_ATMEGA328P=y
CONFIG_BOARD_ATMEGA328P=y
```

## cmake/defconfigs/cortex-m4_stm32f4_nucleo_f401re.defconfig
```kconfig
# NavHAL defconfig — ARM Cortex-M4 / STM32F4 / Nucleo-F401RE.
#
# Minimal Kconfig fragment: selects the arch / vendor / family / board.
# Everything else (drivers, sample selection, capability flags) cascades
# from Kconfig defaults.
#
# Used by cmake/toolchains/arm-none-eabi-toolchain.cmake — when that
# toolchain file is active, CMakeLists.txt copies this into .config before
# running tools/kconfig.py.

CONFIG_ARCH_CORTEX_M4=y
CONFIG_VENDOR_STM32=y
CONFIG_FAMILY_STM32F4=y
CONFIG_BOARD_NUCLEO_F401RE=y
```

## src/arch/armv7e-m/Kconfig
```kconfig
# vim: ft=kconfig
# Per-arch identity + build defaults for the armv7e-m ISA (M7 §7.2).
# Sourced unconditionally at top level. Every "default ... if ARCH_*"
# is gated on this arch's choice symbol, so only the selected arch
# contributes a value. Several arches defining the same string symbol
# is intentional — kconfiglib merges the defaults; the prompted build
# knobs (TOOLCHAIN_PREFIX / FLASHER / FLASH_ADDRESS) are declared once
# in the root and only have their per-arch default added here.

# CMAKE_SYSTEM_PROCESSOR names a specific core; ARCH_ISA is the
# source-tree slug for the ISA layer (src/arch/<ARCH_ISA>/). A single
# ISA covers multiple processors (Cortex-M3/M4/M7 share armv7e-m
# startup, NVIC, SysTick), so the two are distinct axes.
config CMAKE_SYSTEM_PROCESSOR
    string
    default "cortex-m4" if ARCH_CORTEX_M4

config ARCH_ISA
    string
    default "armv7e-m" if ARCH_CORTEX_M4

config TOOLCHAIN_PREFIX
    default "arm-none-eabi-" if ARCH_CORTEX_M4

config FLASHER
    default "st-flash" if ARCH_CORTEX_M4

config FLASH_ADDRESS
    default "0x8000000" if ARCH_CORTEX_M4
```

## src/arch/armv7e-m/Kconfig.choice
```kconfig
# vim: ft=kconfig
# Processor Architecture choice entry for the armv7e-m ISA (M7 §7.2).
# Sourced inside the root "Processor Architecture" choice.

config ARCH_CORTEX_M4
    bool "Cortex-M4"
```

## src/arch/avr/Kconfig
```kconfig
# vim: ft=kconfig
# Per-arch identity + build defaults for the AVR8 ISA (M7 §7.2).
# See src/arch/armv7e-m/Kconfig for the conventions; the prompted build
# knobs are declared in the root and only get their per-arch default here.

config CMAKE_SYSTEM_PROCESSOR
    string
    default "avr" if ARCH_AVR8

config ARCH_ISA
    string
    default "avr" if ARCH_AVR8

config TOOLCHAIN_PREFIX
    default "avr-" if ARCH_AVR8

config FLASHER
    default "avrdude" if ARCH_AVR8

config FLASH_ADDRESS
    default "0x0" if ARCH_AVR8
```

## src/arch/avr/Kconfig.choice
```kconfig
# vim: ft=kconfig
# Processor Architecture choice entry for the AVR8 ISA (M7 §7.2).
# Sourced inside the root "Processor Architecture" choice.

config ARCH_AVR8
    bool "AVR8 (8-bit)"
    help
      8-bit AVR architecture (ATmega / ATtiny). Implemented by the M6
      port; arch sources live under src/arch/avr/.
```

## src/board/atmega328p/Kconfig.choice
```kconfig
# vim: ft=kconfig
# Target-board choice entry for the bare ATmega328P board (M7 §7.2).
# Sourced inside the root "Target Board" choice. Visible only when its
# family is selected, so it auto-selects then.

config BOARD_ATMEGA328P
    bool "atmega328p"
    depends on FAMILY_ATMEGA328P
```

## src/board/nucleo_f401re/Kconfig.choice
```kconfig
# vim: ft=kconfig
# Target-board choice entry for Nucleo-F401RE (M7 §7.2).
# Sourced inside the root "Target Board" choice. Visible only when its
# family is selected, so it auto-selects then.

config BOARD_NUCLEO_F401RE
    bool "nucleo_f401re"
    depends on FAMILY_STM32F4
```

## src/board/nucleo_f767zi/Kconfig.choice
```kconfig
# vim: ft=kconfig
# Target-board choice entry for Nucleo-F767ZI (M7 §7.2).
# Sourced inside the root "Target Board" choice. Visible only when its
# family is selected, so it auto-selects then.

config BOARD_NUCLEO_F767ZI
    bool "nucleo_f767zi"
    depends on FAMILY_STM32F7
```

## src/vendor/microchip/Kconfig
```kconfig
# vim: ft=kconfig
# Vendor identity string for Microchip (M7 §7.2). Sourced at top level.

config VENDOR
    string
    default "microchip" if VENDOR_MICROCHIP
```

## src/vendor/microchip/Kconfig.choice
```kconfig
# vim: ft=kconfig
# Vendor choice entry for Microchip (M7 §7.2).
# Sourced inside the root "Vendor" choice. Visible only on AVR8, so it
# auto-selects when that arch is active — no explicit choice default
# needed.

config VENDOR_MICROCHIP
    bool "Microchip"
    depends on ARCH_AVR8
    help
      Microchip (formerly Atmel) AVR silicon.
```

## src/vendor/microchip/family/atmega328p/Kconfig
```kconfig
# vim: ft=kconfig
# Family identity string for ATmega328P (M7 §7.2). Sourced at top level.

config FAMILY
    string
    default "atmega328p" if FAMILY_ATMEGA328P
```

## src/vendor/microchip/family/atmega328p/Kconfig.choice
```kconfig
# vim: ft=kconfig
# Device-family choice entry for ATmega328P (M7 §7.2).
# Sourced inside the root "Vendor Device Family" choice. Visible only
# when its vendor is selected, so it auto-selects then.

config FAMILY_ATMEGA328P
    bool "ATmega328P"
    depends on VENDOR_MICROCHIP
```

## src/vendor/stm32/Kconfig
```kconfig
# vim: ft=kconfig
# Vendor identity string for STM32 (M7 §7.2). Sourced at top level.

config VENDOR
    string
    default "stm32" if VENDOR_STM32
```

## src/vendor/stm32/Kconfig.choice
```kconfig
# vim: ft=kconfig
# Vendor choice entry for STM32 (M7 §7.2).
# Sourced inside the root "Vendor" choice. Visible only on Cortex-M4,
# so it auto-selects when that arch is active — no explicit choice
# default needed.

config VENDOR_STM32
    bool "STM32"
    depends on ARCH_CORTEX_M4 || ARCH_CORTEX_M7
```

## src/vendor/stm32/family/stm32f4/Kconfig
```kconfig
# vim: ft=kconfig
# Family identity string for STM32F4 (M7 §7.2). Sourced at top level.

config FAMILY
    string
    default "stm32f4" if FAMILY_STM32F4
```

## src/vendor/stm32/family/stm32f4/Kconfig.choice
```kconfig
# vim: ft=kconfig
# Device-family choice entry for STM32F4 (M7 §7.2).
# Sourced inside the root "Vendor Device Family" choice. Visible only
# when its vendor is selected, so it auto-selects then.

config FAMILY_STM32F4
    bool "STM32F4 (Cortex-M4)"
    depends on VENDOR_STM32
```

## src/vendor/stm32/family/stm32f7/Kconfig
```kconfig
# vim: ft=kconfig
# Family identity string for STM32F7 (M7 §7.2). Sourced at top level.

config FAMILY
    string
    default "stm32f7" if FAMILY_STM32F7
```

## src/vendor/stm32/family/stm32f7/Kconfig.choice
```kconfig
# vim: ft=kconfig
# Device-family choice entry for STM32F7 (M7 §7.2).
# Sourced inside the root "Vendor Device Family" choice. Gated on
# ARCH_CORTEX_M7 so exactly one family is visible per arch selection
# (STM32F4 on Cortex-M4, STM32F7 on Cortex-M7) — the choice then
# auto-selects its single visible member.

config FAMILY_STM32F7
    bool "STM32F7 (Cortex-M7)"
    depends on VENDOR_STM32 && ARCH_CORTEX_M7
```
