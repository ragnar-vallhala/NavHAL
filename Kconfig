## samples/Kconfig
```kconfig
# NavHAL samples — M7 §7.3.
#
# Sourced from the root Kconfig's "Build Options" menu. Adding a new sample
# is one new `config SAMPLE_<NN>_<NAME>` entry here, plus the matching
# `default "<slug>" if SAMPLE_<NN>_<NAME>` line at the bottom.
#
# `depends on ARCH_CORTEX_M4` gates samples that need a cortex-specific
# peripheral or driver; `select DRV_<X>` pulls in the cap a sample needs
# so users running with a stripped .config still get the right driver
# linked in (the build_all_samples CI matrix catches missing selects).

choice
    prompt "Sample Application"
    default SAMPLE_NONE
    help
      Select the sample application to compile.

config SAMPLE_NONE
    bool "None"

config SAMPLE_01_HAL_BLINK
    bool "01_hal_blink"

config SAMPLE_01_NO_HAL_BLINK
    bool "01_no_hal_blink"
    depends on ARCH_CORTEX_M4

config SAMPLE_02_HAL_PUPD
    bool "02_hal_pupd"

config SAMPLE_03_HAL_UART_TX
    bool "03_hal_uart_tx"

config SAMPLE_03_NO_HAL_UART_TX
    bool "03_no_hal_uart_tx"
    depends on ARCH_CORTEX_M4

config SAMPLE_04_HAL_TIMER
    bool "04_hal_timer"

config SAMPLE_05_HAL_SYSTICK
    bool "05_hal_systick"
    depends on ARCH_CORTEX_M4

config SAMPLE_06_HAL_BLINK_DELAY
    bool "06_hal_blink_delay"

config SAMPLE_07_HAL_PWM
    bool "07_hal_pwm"
    select DRV_PWM

config SAMPLE_08_NO_HAL_PWM
    bool "08_no_hal_pwm"
    depends on ARCH_CORTEX_M4

config SAMPLE_09_HAL_CLOCK
    bool "09_hal_clock"
    depends on ARCH_CORTEX_M4

config SAMPLE_10_NO_HAL_I2C
    bool "10_no_hal_i2c"
    depends on ARCH_CORTEX_M4

config SAMPLE_11_HAL_I2C
    bool "11_hal_i2c"
    select DRV_I2C

config SAMPLE_12_NO_HAL_FLASH
    bool "12_no_hal_flash"
    depends on ARCH_CORTEX_M4

config SAMPLE_13_HAL_FLASH
    bool "13_hal_flash"
    select DRV_FLASH

config SAMPLE_14_HAL_UART_INT
    bool "14_hal_uart_int"

config SAMPLE_15_HAL_UART_DMA
    bool "15_hal_uart_dma"
    depends on ARCH_CORTEX_M4 || ARCH_CORTEX_M7

config SAMPLE_16_HAL_DMA_POLLING_UART
    bool "16_hal_dma_polling_uart"
    depends on ARCH_CORTEX_M4

config SAMPLE_17_HAL_FPU
    bool "17_hal_fpu"
    depends on ARCH_CORTEX_M4

config SAMPLE_18_HAL_CRC
    bool "18_hal_crc"
    select DRV_CRC

config SAMPLE_19_HAL_DMA_I2C
    bool "19_hal_dma_i2c"
    depends on ARCH_CORTEX_M4 || ARCH_CORTEX_M7
    select DRV_I2C

config SAMPLE_20_HAL_SDIO
    bool "20_hal_sdio"
    depends on ARCH_CORTEX_M4 || ARCH_CORTEX_M7
    select DRV_SDIO

config SAMPLE_21_HAL_SDIO_BLOCK
    bool "21_hal_sdio_block"
    depends on ARCH_CORTEX_M4 || ARCH_CORTEX_M7
    select DRV_SDIO

config SAMPLE_22_HAL_FATFS_POSIX
    bool "22_hal_fatfs_posix"
    depends on ARCH_CORTEX_M4 || ARCH_CORTEX_M7
    select DRV_SDIO

config SAMPLE_23_HAL_SDIO_PERF
    bool "23_hal_sdio_perf"
    depends on ARCH_CORTEX_M4 || ARCH_CORTEX_M7
    select DRV_SDIO

config SAMPLE_24_HAL_UART_DMA_BRIDGE
    bool "24_hal_uart_dma_bridge"
    depends on ARCH_CORTEX_M4 || ARCH_CORTEX_M7

config SAMPLE_25_HAL_SPI_ESP_BRIDGE
    bool "25_hal_spi_esp_bridge"
    select DRV_SPI

config SAMPLE_26_HAL_DWT
    bool "26_hal_dwt"
    depends on ARCH_CORTEX_M4
    select DRV_DWT
    select DRV_UART
    select DRV_FPU
    select USE_FPU

config SAMPLE_28_HAL_MPU
    bool "28_hal_mpu"
    depends on ARCH_CORTEX_M4 || ARCH_CORTEX_M7
    select DRV_MPU
    select DRV_UART
    select DRV_CLOCK

config SAMPLE_29_HAL_ETH
    bool "29_hal_eth"
    depends on ARCH_CORTEX_M7
    select DRV_ETH
    select DRV_UART
    select DRV_CLOCK

config SAMPLE_30_HAL_ETH_BRIDGE
    bool "30_hal_eth_bridge"
    depends on ARCH_CORTEX_M7
    select DRV_ETH
    select DRV_UART
    select DRV_CLOCK

config SAMPLE_31_HAL_ETH_ECHO
    bool "31_hal_eth_echo"
    depends on ARCH_CORTEX_M7
    select DRV_ETH
    select DRV_UART
    select DRV_CLOCK

config SAMPLE_32_HAL_MPU_FAULT
    bool "32_hal_mpu_fault"
    depends on ARCH_CORTEX_M4 || ARCH_CORTEX_M7
    select DRV_MPU
    select DRV_UART
    select DRV_INTERRUPT

config SAMPLE_33_HAL_ADC
    bool "33_hal_adc"
    select DRV_ADC
    select DRV_UART

config SAMPLE_36_HAL_WATCHDOG
    bool "36_hal_watchdog"
    select DRV_RESET
    select DRV_WATCHDOG
    select DRV_UART

config SAMPLE_37_HAL_BOOT_SNIFFER
    bool "37_hal_boot_sniffer"
    depends on ARCH_CORTEX_M4 && FAMILY_STM32F4
    select DRV_CLOCK
    select DRV_GPIO
    select DRV_INTERRUPT
    select DRV_TIMEBASE
    select DRV_UART
    select DRV_DMA
    select DRV_UART_DMA
    select DRV_RESET
    select DRV_USB_CDC
    select BOOT_SNIFFER

config SAMPLE_38_HAL_FLASH_ART
    bool "38_hal_flash_art"
    depends on ARCH_CORTEX_M4 || ARCH_CORTEX_M7
    select DRV_CLOCK
    select DRV_GPIO
    select DRV_UART
    select DRV_TIMEBASE
    select DRV_DWT

config SAMPLE_35_HAL_RTC
    bool "35_hal_rtc"
    depends on ARCH_CORTEX_M4 && FAMILY_STM32F4
    select DRV_RTC
    select DRV_USB_CDC

config SAMPLE_34_HAL_USB_CDC
    bool "34_hal_usb_cdc"
    depends on ARCH_CORTEX_M4 && FAMILY_STM32F4
    select DRV_USB_CDC

config SAMPLE_00_HAL_X86_HELLO
    bool "00_hal_x86_hello"
    depends on ARCH_X86_64

config SAMPLE_01_HAL_X86_TIMING
    bool "01_hal_x86_timing"
    depends on ARCH_X86_64

config SAMPLE_02_HAL_X86_INTERRUPT
    bool "02_hal_x86_interrupt"
    depends on ARCH_X86_64

config SAMPLE_03_HAL_X86_ECHO
    bool "03_hal_x86_echo"
    depends on ARCH_X86_64

endchoice

config SAMPLE
    string
    default "" if SAMPLE_NONE
    default "hal_x86_hello" if SAMPLE_00_HAL_X86_HELLO
    default "hal_x86_timing" if SAMPLE_01_HAL_X86_TIMING
    default "hal_x86_interrupt" if SAMPLE_02_HAL_X86_INTERRUPT
    default "hal_x86_echo" if SAMPLE_03_HAL_X86_ECHO
    default "hal_blink" if SAMPLE_01_HAL_BLINK
    default "no_hal_blink" if SAMPLE_01_NO_HAL_BLINK
    default "hal_pupd" if SAMPLE_02_HAL_PUPD
    default "hal_uart_tx" if SAMPLE_03_HAL_UART_TX
    default "no_hal_uart_tx" if SAMPLE_03_NO_HAL_UART_TX
    default "hal_timer" if SAMPLE_04_HAL_TIMER
    default "hal_systick" if SAMPLE_05_HAL_SYSTICK
    default "hal_blink_delay" if SAMPLE_06_HAL_BLINK_DELAY
    default "hal_pwm" if SAMPLE_07_HAL_PWM
    default "no_hal_pwm" if SAMPLE_08_NO_HAL_PWM
    default "hal_clock" if SAMPLE_09_HAL_CLOCK
    default "no_hal_i2c" if SAMPLE_10_NO_HAL_I2C
    default "hal_i2c" if SAMPLE_11_HAL_I2C
    default "no_hal_flash" if SAMPLE_12_NO_HAL_FLASH
    default "hal_flash" if SAMPLE_13_HAL_FLASH
    default "hal_uart_int" if SAMPLE_14_HAL_UART_INT
    default "hal_uart_dma" if SAMPLE_15_HAL_UART_DMA
    default "hal_dma_polling_uart" if SAMPLE_16_HAL_DMA_POLLING_UART
    default "hal_fpu" if SAMPLE_17_HAL_FPU
    default "hal_crc" if SAMPLE_18_HAL_CRC
    default "hal_dma_i2c" if SAMPLE_19_HAL_DMA_I2C
    default "hal_sdio" if SAMPLE_20_HAL_SDIO
    default "hal_sdio_block" if SAMPLE_21_HAL_SDIO_BLOCK
    default "hal_fatfs_posix" if SAMPLE_22_HAL_FATFS_POSIX
    default "hal_sdio_perf" if SAMPLE_23_HAL_SDIO_PERF
    default "hal_uart_dma_bridge" if SAMPLE_24_HAL_UART_DMA_BRIDGE
    default "hal_spi_esp_bridge" if SAMPLE_25_HAL_SPI_ESP_BRIDGE
    default "hal_dwt" if SAMPLE_26_HAL_DWT
    default "hal_mpu" if SAMPLE_28_HAL_MPU
    default "hal_eth" if SAMPLE_29_HAL_ETH
    default "hal_eth_bridge" if SAMPLE_30_HAL_ETH_BRIDGE
    default "hal_eth_echo" if SAMPLE_31_HAL_ETH_ECHO
    default "hal_mpu_fault" if SAMPLE_32_HAL_MPU_FAULT
    default "hal_adc" if SAMPLE_33_HAL_ADC
    default "hal_usb_cdc" if SAMPLE_34_HAL_USB_CDC
    default "hal_rtc" if SAMPLE_35_HAL_RTC
    default "hal_watchdog" if SAMPLE_36_HAL_WATCHDOG
    default "hal_flash_art" if SAMPLE_38_HAL_FLASH_ART
    default "hal_boot_sniffer" if SAMPLE_37_HAL_BOOT_SNIFFER
```

## src/arch/armv7e-m/Kconfig.features
```kconfig
# vim: ft=kconfig
# Arch-specific peripheral toggles for the armv7e-m ISA (M7 §7.2).
# Sourced inside the root "System & Features Configuration" menu.
#
# DMA, the hardware FPU, the DWT cycle counter and the FPU runtime are
# Cortex-M peripherals with no ATmega328P equivalent, so they live with
# the arch rather than in the common root. (AVR ships no Kconfig.features
# fragment — there is nothing arch-specific to toggle there yet.)

config USE_FPU
    bool "Enable Hardware FPU Compiler Flags"
    depends on ARCH_CORTEX_M4 || ARCH_CORTEX_M7
    default n
    help
      Enable hardware Floating Point Unit compiler and linker flags.

config DRV_DMA
    bool "Enable Direct Memory Access (DMA)"
    depends on ARCH_CORTEX_M4 || ARCH_CORTEX_M7
    default n
    select DRV_INTERRUPT
    help
      Enables support for the DMA hardware controller.

config DRV_DWT
    bool "Enable Debug Watchpoint and Trace (DWT)"
    depends on ARCH_CORTEX_M4 || ARCH_CORTEX_M7
    default n
    help
      Enables the DWT counter for high-resolution timing.

config DRV_FPU
    bool "Enable FPU Driver Extension"
    depends on ARCH_CORTEX_M4 || ARCH_CORTEX_M7
    default n
    help
      Enables compilation of hardware FPU runtime setup files.

config DRV_MPU
    bool "Enable Memory Protection Unit (MPU)"
    depends on ARCH_CORTEX_M4 || ARCH_CORTEX_M7
    default n
    help
      Enables the ARMv7-M Memory Protection Unit driver (region-based
      access control). Region count is silicon-dependent (8 on M4,
      16 on M7) and read at runtime from MPU_TYPE.DREGION.

config DRV_CACHE
    bool "Enable L1 cache driver (Cortex-M7)"
    depends on ARCH_CORTEX_M7
    default n
    help
      Enables the hal_cache driver for the Cortex-M7 L1 caches: the
      instruction cache (hal_icache_enable, a hazard-free performance win) and
      the data cache (hal_dcache_enable plus the clean/invalidate maintenance
      the DMA drivers use to stay coherent). The Cortex-M4 has no L1 cache, so
      this option is not offered there.

config CACHE_AT_BOOT
    bool "Turn the L1 caches on before main()"
    depends on DRV_CACHE
    default y
    help
      Enables the instruction and data caches in the startup path, so an
      application gets them without asking. Measured on a Nucleo-F767ZI at
      216 MHz, a flash-resident workload runs 2.7x faster with both on.

      Both, or neither: with only one enabled the other path still stalls on
      flash and the stalls dominate -- the instruction cache alone measured
      slightly slower than no cache at all (samples/cortex-m/38_hal_flash_art).

      The data cache is only safe because every DMA path in the HAL maintains
      its buffers: eth cleans and invalidates its descriptors and frames, sdio
      and i2c go through navhal_dma_{tx_prepare,rx_guard,rx_finish}, and uart
      does the same plus hal_uart_dma_rx_sync for its ring. An application
      that hands its own buffer to a HAL DMA call is covered by those. One
      that drives a peripheral's DMA directly, or reads a ring the HAL filled,
      has to maintain that buffer itself -- turn this off if that is not done.

config USE_TCM
    bool "Enable tightly-coupled memory placement (Cortex-M7)"
    depends on ARCH_CORTEX_M7
    default n
    help
      Activates the NAVHAL_ITCM / NAVHAL_DTCM / NAVHAL_DTCM_NOINIT placement
      attributes (common/hal_tcm.h), letting code and data be pinned into the
      Cortex-M7's 0-wait instruction/data TCMs. The board startup copies the
      .itcm / .dtcm sections from flash at reset. M4 has no TCM, so this option
      is not offered there; with it off, the attributes are no-ops.
```
